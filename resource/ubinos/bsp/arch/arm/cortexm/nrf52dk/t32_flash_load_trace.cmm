;
; Copyright (C) 2009 Sung Ho Park
; Contact: ubinos.org@gmail.com
;
; This file is part of the bsp_sam7x256ek component of the Ubinos.
;
; GNU General Public License Usage
; This file may be used under the terms of the GNU
; General Public License version 3.0 as published by the Free Software
; Foundation and appearing in the file license_gpl3.txt included in the
; packaging of this file. Please review the following information to
; ensure the GNU General Public License version 3.0 requirements will be
; met: http://www.gnu.org/copyleft/gpl.html.
;
; GNU Lesser General Public License Usage
; Alternatively, this file may be used under the terms of the GNU Lesser
; General Public License version 2.1 as published by the Free Software
; Foundation and appearing in the file license_lgpl.txt included in the
; packaging of this file. Please review the following information to
; ensure the GNU Lesser General Public License version 2.1 requirements
; will be met: http://www.gnu.org/licenses/old-licenses/lgpl-2.1.html.
;
; Commercial Usage
; Alternatively, licensees holding valid commercial licenses may 
; use this file in accordance with the commercial license agreement 
; provided with the software or, alternatively, in accordance with the 
; terms contained in a written agreement between you and rightful owner.
;

; --------------------------------------------------------------------------------

print "begin"

; --------------------------------------------------------------------------------
; initialize and start the debugger

RESet
SYStem.RESet
SYStem.CPU NRF52832QFAA
SYStem.CONFIG.DEBUGPORTTYPE SWD
IF hardware.COMBIPROBE()||hardware.UTRACE()
(
  ; The trace was tested on a  nRF52 Development Kit without trace signals on a debug header.
  ; To test the trace a test adapter has used, that maps the trace signals according to the
  ; MIPI34 spec.
  SYStem.CONFIG.CONNECTOR MIPI34
)
SYStem.Option DUALPORT ON
SYStem.MemAccess DAP
SYStem.JtagClock CTCK 10MHz
SYStem.Up

; --------------------------------------------------------------------------------
; Setup pin multiplexing for parallel trace.
Data.Set AD:0x4000055C %Long 0x00020000    ; Set CLOCK.TRACECONFIG.TRACEMUX to Parallel
; Inclease driver strength GPIO.PIN_CNF[x].DRIVE = H0H1
Data.Set AD:0x50000738 %Long 0x00000303    ; Port 14 (TRACEDATA3)
Data.Set AD:0x5000073C %Long 0x00000303    ; Port 15 (TRACEDATA2)
Data.Set AD:0x50000740 %Long 0x00000303    ; Port 16 (TRACEDATA1)
Data.Set AD:0x50000748 %Long 0x00000303    ; Port 18 (TRACEDATA0)
Data.Set AD:0x50000750 %Long 0x00000303    ; Port 20 (TRACECLK)

; --------------------------------------------------------------------------------
; initialize offchip-trace (ETM ON, ITM ON)
IF hardware.COMBIPROBE()||hardware.UTRACE()||Analyzer()
(
  ; set PinMux and enable Clocks

  TPIU.PortSize 4
  TPIU.PortMode Continuous
  ITM.DataTrace CorrelatedData
  ITM.ON
  ETM.Trace ON
  ETM.ON
)
IF hardware.COMBIPROBE()||hardware.UTRACE()
(
  Trace.METHOD CAnalyzer
  Trace.AutoInit ON
  IF VERSION.BUILD.BASE()>=74752.
  (
    CAnalyzer.AutoFocus
  )
  ELSE
  (
    ; for uTrace & Combiprobe use manual calibration
    ; CAnalyzer.ClockDELAY Large
  )
)
IF Analyzer()
(
  Trace.METHOD Analyzer
  Trace.AutoInit ON
  Trace.AutoFocus
)

; --------------------------------------------------------------------------------
; Flash programming

; prepare flash programming (declarations)
&flashsize=0x80000
&pagesize=0x1000

FLASH.RESet
FLASH.Create 1. 0x00000000++(&flashsize-1) &pagesize TARGET Long
FLASH.Create 2. 0x10001000++0x0FFF &pagesize NOP Long  ; UICR area

FLASH.TARGET 0x20000000 0x20001000 0x800 ~~~~/flash_writer.elf

; ReProgram Flash
FLASH.ReProgram ALL
Data.LOAD.Elf ~~~~/app.elf
FLASH.ReProgram OFF

; --------------------------------------------------------------------------------

Register.Set PC Reset_Handler

Break.Set main
Mode.Hll

; --------------------------------------------------------------------------------

print "end"

ENDDO


